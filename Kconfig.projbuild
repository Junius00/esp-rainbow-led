## Kconfig.projbuild
```kconfig
menu "Rainbow LED Configuration"

    config RAINBOW_LED_TASK_STACK_SIZE
        int "Task stack size"
        default 2048
        help
            The stack size of the task used to change the LED parameters.
    
    config RAINBOW_LED_TASK_PRIORITY
        int "Task priority"
        default 1
        help
            The priority of the task used to change the LED parameters.

endmenu
```

## examples/get_started/sdkconfig.defaults.esp32s3
```kconfig
CONFIG_APP_BUTTON_GPIO_NUM=0
CONFIG_APP_LED_TYPE_WS2812=y
#
# Please Note:
# ESP32-S3-DevKitC v1.1 uses GPIO38 for the on-board LED
# ESP32-S3-DevKitC v1.0 uses GPIO48 for the on-board LED
#
CONFIG_APP_LED_WS2812_GPIO_NUM=48
```
